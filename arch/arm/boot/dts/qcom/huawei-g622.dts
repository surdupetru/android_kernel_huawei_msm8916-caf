/* Copyright (c) 2014, The Linux Foundation. All rights reserved.
 * Copyright (c) 2016, @surdu_petru
 *
 * This program is free software; you can redistribute it and/or modify
 * it under the terms of the GNU General Public License version 2 and
 * only version 2 as published by the Free Software Foundation.
 *
 * This program is distributed in the hope that it will be useful,
 * but WITHOUT ANY WARRANTY; without even the implied warranty of
 * MERCHANTABILITY or FITNESS FOR A PARTICULAR PURPOSE.  See the
 * GNU General Public License for more details.
 */
/dts-v1/;

#include "msm8916-qrd.dtsi"
#include "msm8916-memory.dtsi"
#include "dsi-panel-innolux-720p-video.dtsi"
#include "huawei-g622/huawei-g622.dtsi"

/ {
	model = "Qualcomm MSM 8916 QRD G622CL";
	compatible = "qcom,msm8916-qrd-skuh", "qcom,msm8916-qrd", "qcom,msm8916", "qcom,qrd";
	qcom,board-id = <8036 0> , <8036 4>, <8037 0> , <8037 4>;
};

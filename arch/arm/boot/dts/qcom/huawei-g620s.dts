/* Copyright (c) 2014, The Linux Foundation. All rights reserved.
 * Copyright (c) 2016, @surdu_petru
 *
 * This program is free software; you can redistribute it and/or modify
 * it under the terms of the GNU General Public License version 2 and
 * only version 2 as published by the Free Software Foundation.
 *
 * This program is distributed in the hope that it will be useful,
 * but WITHOUT ANY WARRANTY; without even the implied warranty of
 * MERCHANTABILITY or FITNESS FOR A PARTICULAR PURPOSE.  See the
 * GNU General Public License for more details.
 */
/dts-v1/;

#include "msm8916-qrd.dtsi"
#include "msm8916-memory.dtsi"
#include "huawei-g620s/huawei-g620s.dtsi"

/ {
	model = "Qualcomm MSM 8916 QRD G620S-L01";
	compatible = "qcom,msm8916-qrd-skuh", "qcom,msm8916-qrd", "qcom,msm8916", "qcom,qrd";
	qcom,board-id =	<0x1000b 0>, <0x1000b 4>, <0x1010b 0>, <0x1010b 4>, <0x2010b 0>, <0x2010b 4>, 
			<8102 0>, <8102 4>, <8104 0>, <8104 4>,	<8118 0>, <8118 4>, <8120 0>, <8120 4>,
			<8134 0>, <8134 4>, <8136 0>, <8136 4>,	<8116 0>, <8116 4>, <8117 0>, <8117 4>,
			<8103 0>, <8103 4>;
};
